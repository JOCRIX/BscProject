----------------------------------------------------------------------------------
-- Company: 
-- Engineer: 
-- 
-- Create Date: 14.10.2024 13:23:48
-- Design Name: 
-- Module Name: DAC_PRESCALER - Behavioral
-- Project Name: 
-- Target Devices: 
-- Tool Versions: 
-- Description: 
-- 
-- Dependencies: 
-- 
-- Revision:
-- Revision 0.01 - File Created
-- Additional Comments:
-- 
----------------------------------------------------------------------------------


library IEEE;
use IEEE.STD_LOGIC_1164.ALL;

-- Uncomment the following library declaration if using
-- arithmetic functions with Signed or Unsigned values
--use IEEE.NUMERIC_STD.ALL;

-- Uncomment the following library declaration if instantiating
-- any Xilinx leaf cells in this code.
--library UNISIM;
--use UNISIM.VComponents.all;

entity DAC_PRESCALER is
    Port ( 
           CLK_IN : in STD_LOGIC; --The clock input, this is divided down by two to generate the DAC and DDS clocks. 100 MHz for 50 MHz DAC opperation.
           CLK_TO_DDS : out STD_LOGIC; -- The diveded down clock for the DDS.
           CLK_TO_DAC : out STD_LOGIC -- The clock for the DAC, a delayed version of the DDS clock.
           );
end DAC_PRESCALER;

-- When this is to be used with internal memory, the outcommentet SET_F_IN_L is to be "incommentet" again.
-- As of right not this is set up so that the frequnecy is programmed via external dip-switches.

architecture Behavioral of DAC_PRESCALER is

signal sig_CLK_TO_DDS : std_logic := '0';    

begin
    process(CLK_IN, sig_CLK_TO_DDS)
    begin 
        if (rising_edge(CLK_IN)) then -- If a rising edge occurs on the main clock, togle the internal signal sig_CLK_TO_DDS. effectivly dividing by two.
            sig_CLK_TO_DDS <= not sig_CLK_TO_DDS;
        end if;
    end process;
    CLK_TO_DDS <= sig_CLK_TO_DDS;       --connect CLK to DDS to sig_CLK_TO_DDS, such that the downconverted frequency can clock the DDS IP.
    CLK_TO_DAC <= (not CLK_IN) and sig_CLK_TO_DDS;  --The DAC clock is generated by using the inverted master clock and the DDS clock.
    
end Behavioral;
