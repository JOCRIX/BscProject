----------------------------------------------------------------------------------
-- Company: 
-- Engineer: 
-- 
-- Create Date: 14.10.2024 13:23:48
-- Design Name: 
-- Module Name: DAC_PRESCALER - Behavioral
-- Project Name: 
-- Target Devices: 
-- Tool Versions: 
-- Description: 
-- 
-- Dependencies: 
-- 
-- Revision:
-- Revision 0.01 - File Created
-- Additional Comments:
-- 
----------------------------------------------------------------------------------


library IEEE;
use IEEE.STD_LOGIC_1164.ALL;

-- Uncomment the following library declaration if using
-- arithmetic functions with Signed or Unsigned values
--use IEEE.NUMERIC_STD.ALL;

-- Uncomment the following library declaration if instantiating
-- any Xilinx leaf cells in this code.
--library UNISIM;
--use UNISIM.VComponents.all;

entity DAC_PRESCALER is
    Port ( 
           CLK_IN : in STD_LOGIC; --The clock input, this is divided down by two to generate the DAC and DDS clocks. 100 MHz for 50 MHz DAC opperation.
           CLK_TO_DDS : out STD_LOGIC; -- The diveded down clock for the DDS.
           CLK_TO_DAC : out STD_LOGIC; -- The clock for the DAC, a delayed version of the DDS clock.
           --SET_F_IN_L : in std_logic_vector(15 downto 0); --bit 0 to 15 of the 32 bit wide phase word.
           SET_F_IN_H : in std_logic_vector(31 downto 16); --bit 16 to 31 of the 32 bit wide phase word.
           F_OUT : out std_logic_vector(31 downto 0); --The full 32 bit wide phase word for the DDS.
           DDS_DATA_IN : in std_logic_vector(15 downto 0); --DDS output data, in two's compliment.
           DAC_DATA_OUT : out std_logic_vector(15 downto 0); --DDS data converted to unsigned, this is the Data for the DAC.
           UPDATE_F : out std_logic
           );
end DAC_PRESCALER;

-- When this is to be used with internal memory, the outcommentet SET_F_IN_L is to be "incommentet" again.
-- As of right not this is set up so that the frequnecy is programmed via external dip-switches.

architecture Behavioral of DAC_PRESCALER is

signal sig_CLK_TO_DDS : std_logic := '0';    
signal sig_f_in : std_logic_vector (31 downto 0) := (others => '0');
signal sig_update_f : std_logic := '0';
signal sig_f_out : std_logic_vector (31 downto 0) := (others => '0');

begin
    process(CLK_IN, sig_CLK_TO_DDS)
    begin 
        if (rising_edge(CLK_IN)) then -- If a rising edge occurs on the main clock, togle the internal signal sig_CLK_TO_DDS. effectivly dividing by two.
            sig_CLK_TO_DDS <= not sig_CLK_TO_DDS;
        end if;
    end process;
    CLK_TO_DDS <= sig_CLK_TO_DDS;       --connect CLK to DDS to sig_CLK_TO_DDS, such that the downconverted frequency can clock the DDS IP.
    CLK_TO_DAC <= (not CLK_IN) and sig_CLK_TO_DDS;  --The DAC clock is generated by using the inverted master clock and the DDS clock.
    
    
    -- If the DDS is to be set using two interal 16 bit registers, outcomment the current concatenation.
    --sig_f_in <= SET_F_IN_H & SET_F_IN_L;        -- "Incomment" here
    sig_f_in <= SET_F_IN_H & "0000000000000000";  -- Outcomment here
    
    UPDATE_F <= sig_update_f; 
    F_OUT <= sig_f_out;
    
    process (sig_f_out, sig_f_in, CLK_IN)
    begin
        if(rising_edge(CLK_IN)) then  -- When a rising edge on the master clock occurs, check if the current frequency setting is the same as before.
            if (sig_f_out /= sig_f_in) then     --if it is not the same, then set the phase word to the DDS to the new value and togle the
                sig_f_out <= sig_f_in;              --frequency update pin.
                sig_update_f <= '1';
            else
                sig_update_f <= '0';
            end if;
        end if;
    end process;
            
    DAC_DATA_OUT <= DDS_DATA_IN xor x"8000"; -- convert the twos compliment DDS DATA to unsigned, the DAC requires unsigned.
end Behavioral;
